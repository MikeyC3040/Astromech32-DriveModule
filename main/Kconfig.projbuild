## main/Kconfig.projbuild
```kconfig
menu "Project Debug Settings"
    config USE_DEBUG
        bool "Use Debug"
        default y
        help
            Use ReelTwo Debug
    config USE_MOTOR_DEBUG
        bool "Use Motor Debug"
        default y
        help
            Use ReelTwo Motor Debug
    config DEBUG_JOYSTICK
        bool "Use Joystick Debug"
        default y
        help
            Prints BP32 Gamepad data
endmenu
```
